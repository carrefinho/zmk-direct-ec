/*
 * Copyright (c) 2026 carrefinho
 * SPDX-License-Identifier: MIT
 */

/ {
	chosen {
		zephyr,shell-uart = &snippet_direct_ec_shell_uart;
	};
};

&zephyr_udc0 {
	snippet_direct_ec_shell_uart: snippet_direct_ec_shell_uart {
		compatible = "zephyr,cdc-acm-uart";
	};
};

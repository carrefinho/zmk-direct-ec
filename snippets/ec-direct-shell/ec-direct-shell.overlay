/*
 * Copyright (c) 2026 carrefinho
 * SPDX-License-Identifier: MIT
 */

/ {
	chosen {
		zephyr,shell-uart = &snippet_ec_direct_shell_uart;
	};
};

&zephyr_udc0 {
	snippet_ec_direct_shell_uart: snippet_ec_direct_shell_uart {
		compatible = "zephyr,cdc-acm-uart";
	};
};
